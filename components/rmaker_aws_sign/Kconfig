## components/rmaker_aws_sign/Kconfig
```kconfig
menu "RainMaker AWS SigV4 Signing"

    config ESP_RMAKER_AWS_SIGN_DISABLE_DEFAULT_PORT
        bool "Do not build the default ESP-IDF port"
        default n
        help
            Drops src/esp_rmaker_aws_sign_default.c and port/esp/* from the build, along with
            esp_rmaker_aws_sign_port_install_default(). Only esp_rmaker_aws_sign_port_install()
            remains, so the application must supply its own port.

            Leaving this disabled still lets the linker strip the default port from any
            application that never calls esp_rmaker_aws_sign_port_install_default() - this
            option only makes the guarantee a compile-time one instead of a link-time one.

    config ESP_RMAKER_AWS_SIGN_MIN_VALID_EPOCH
        int "Minimum plausible wall-clock epoch (seconds)"
        default 1735689600
        help
            Fallback trustworthy-clock threshold, used when the installed port supplies no
            time.is_synced(). The default is 2025-01-01T00:00:00Z. A clock at or below this
            is treated as unsynchronised and AWS calls fail with ESP_ERR_INVALID_STATE
            before any network I/O.

    config ESP_RMAKER_AWS_SIGN_CREDS_HTTP_TIMEOUT_MS
        int "Credential-provider HTTP timeout (ms)"
        default 10000

    config ESP_RMAKER_AWS_SIGN_CREDS_RESPONSE_MAX
        int "Credential-provider max response size (bytes)"
        default 4096

    config ESP_RMAKER_AWS_SIGN_CREDS_REFRESH_MARGIN_SEC
        int "Credential refresh margin (seconds)"
        default 300
        help
            Refresh cached credentials this long before their expiry. If new credentials
            arrive with less than twice this time left, refresh them halfway to their expiry.

    config ESP_RMAKER_AWS_SIGN_CREDS_DEFAULT_TTL_SEC
        int "Credential fallback cache window (seconds)"
        default 3000
        help
            Cache window used when the credential expiration can't be parsed,
            so credentials are not re-fetched on every request.

    config ESP_RMAKER_AWS_SIGN_REQUEST_HTTP_TIMEOUT_MS
        int "Signed-request HTTP timeout (ms)"
        default 15000

    config ESP_RMAKER_AWS_SIGN_HTTP_TX_BUFFER_SIZE
        int "ESP-IDF port HTTP TX buffer size (bytes)"
        depends on !ESP_RMAKER_AWS_SIGN_DISABLE_DEFAULT_PORT
        range 1024 16384
        default 2048
        help
            Each request header must fit in this buffer whole. The x-amz-security-token
            header is usually 0.7-1.5 KB, but AWS does not limit the token length. Raise
            this value if requests fail with "Buffer length is small to fit all the headers".

    config ESP_RMAKER_AWS_SIGN_REQUEST_CONN_IDLE_TIMEOUT_SEC
        int "Signed-request pooled connection idle timeout (seconds)"
        default 10
        help
            Close the pooled keep-alive connection instead of reusing it when it has been
            idle for longer than this, so a request that would have hit a server-side idle
            close pays a fresh handshake rather than a failed round trip. Keep it below the
            peer's idle timeout; S3 closes at roughly 20 seconds. 0 never expires on idle.

    config ESP_RMAKER_AWS_SIGN_REQUEST_RESPONSE_MAX
        int "Signed-request max response size (bytes)"
        default 8192
        help
            A ceiling, not a reservation: the response buffer is sized from the
            Content-Length, or grown from 512 bytes when the reply is chunked.

endmenu
```

## components/rmaker_aws_sign/test_apps/sdkconfig.defaults
```kconfig
CONFIG_UNITY_ENABLE_FLOAT=y
CONFIG_UNITY_ENABLE_DOUBLE=y
CONFIG_UNITY_ENABLE_64BIT=y
CONFIG_UNITY_ENABLE_COLOR=y
CONFIG_UNITY_ENABLE_IDF_TEST_RUNNER=y
CONFIG_UNITY_ENABLE_FIXTURE=y
CONFIG_UNITY_ENABLE_BACKTRACE_ON_FAIL=y

CONFIG_ESP_MAIN_TASK_STACK_SIZE=7168
CONFIG_ESPTOOLPY_FLASHSIZE_4MB=y

# The Unity menu busy-polls the UART for input.
CONFIG_ESP_TASK_WDT_CHECK_IDLE_TASK_CPU0=n
```

## components/rmaker_console/Kconfig
```kconfig
menu "ESP RainMaker Console"

    config ESP_RMAKER_CONSOLE_ENABLED
        bool "Enable RMAKER common console"
        default y
        help
            Enable RainMaker common console.
            If the application has its own console, this can be disabled.

    config ESP_RMAKER_CONSOLE_TASK_STACK
        int "Console task stack"
        default 4096
        help
            Stack size for the console task.

    config ESP_RMAKER_CONSOLE_TASK_PRIORITY
        int "Console task priority"
        default 5
        help
            Priority for the console task.

    config ESP_RMAKER_CONSOLE_USE_REPL
        bool "Use esp_console REPL" if !IDF_TARGET_LINUX
        depends on ESP_RMAKER_CONSOLE_ENABLED
        default y if IDF_TARGET_LINUX
        default n
        help
            Use the esp_console REPL helper (linenoise line editing and history)
            instead of the legacy UART console task.
            The REPL is always used on the Linux target.

    config ESP_RMAKER_CONSOLE_MAX_HISTORY_LEN
        int "Console command history length"
        depends on ESP_RMAKER_CONSOLE_USE_REPL
        range 1 10
        default 5
        help
            Maximum number of commands kept in the console history (linenoise).
            Higher values use more RAM. Minimum is 1 (the REPL helper rejects 0).

endmenu
```

## components/rmaker_work_queue/Kconfig
```kconfig
menu "ESP RainMaker Work Queue (defaults)"

    config ESP_RMAKER_WORK_QUEUE_SIZE
        int "ESP RainMaker Work Queue size"
        range 1 256
        default 8
        help
            Maximum number of pending jobs in the ESP RainMaker Work Queue.
            Each entry uses 8 bytes of internal RAM.

    config ESP_RMAKER_WORK_QUEUE_TASK_STACK
        int "ESP RainMaker Work Queue Task stack"
        default 5120
        help
            Stack size in bytes for the ESP RainMaker Work Queue Task.

    config ESP_RMAKER_WORK_QUEUE_TASK_PRIORITY
        int "ESP RainMaker Work Queue Task priority"
        default 5
        help
            Priority for the ESP RainMaker Work Queue Task. Not recommended to be changed
            unless you really need it.

    config ESP_RMAKER_WORK_QUEUE_PREFER_EXT_RAM
        bool "Prefer external RAM for the ESP RainMaker Work Queue Task stack"
        depends on SPIRAM_ALLOW_STACK_EXTERNAL_MEMORY || FREERTOS_TASK_CREATE_ALLOW_EXT_MEM
        default n
        help
            Whether to prefer to allocate the ESP RainMaker Work Queue Task
            stack in external RAM (SPIRAM), with internal-RAM fallback. The
            TCB is always kept in internal RAM.

            WARNING: A task with its stack in SPIRAM will fault if code runs
            while the flash cache is disabled (e.g. during any NVS/flash
            write, since SPIRAM shares the cache). Do NOT enable this unless
            you can guarantee that no work function scheduled on this queue
            performs flash/NVS writes (or any other cache-disabling
            operation). The global RainMaker work queue does perform NVS
            writes, so leaving this at 'n' is strongly recommended.

endmenu
```
